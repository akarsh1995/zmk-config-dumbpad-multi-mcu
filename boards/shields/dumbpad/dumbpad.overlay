/*
 * Copyright (c) 2022 The ZMK Contributors
 *
 * SPDX-License-Identifier: MIT
 */

 #include "dumbpad.dtsi"

&left_encoder {
    status = "okay";
};

/*
&right_encoder {
    status = "okay";
};
*/
